## conf/distro/include/torizon-iotedge.inc
```bitbake
require conf/distro/include/torizon.inc

USERADD_UID_TABLES = "files/torizon-iotedge-static-passwd"
USERADD_GID_TABLES = "files/torizon-iotedge-static-group"
```

## conf/distro/torizon-iotedge-upstream.conf
```bitbake
require conf/distro/torizon-iotedge.conf

DISTRO = "torizon-upstream-iotedge"
DISTRO_NAME = "TorizonCore Upstream with Azure IoT Edge"

DISTRO_FLAVOUR = " (UPSTREAM)"
DISTRO_FLAVOUR:experimental = " (UPSTREAM EXPERIMENTAL)"

DISTROOVERRIDES .= ":upstream"
```

## conf/distro/torizon-iotedge.conf
```bitbake
require conf/distro/include/torizon.inc
require conf/distro/sota.conf.inc
require conf/distro/include/torizon-iotedge.inc

DISTRO = "torizon-iotedge"
DISTRO_NAME = "TorizonCore with Azure IoT Edge"

DISTRO_FLAVOUR:experimental = " (EXPERIMENTAL)"
```

## conf/layer.conf
```bitbake
# We have a conf and classes directory, add to BBPATH
BBPATH .= ":${LAYERDIR}"

# We have recipes-* directories, add to BBFILES
BBFILES += "${LAYERDIR}/recipes-*/*/*.bb \
            ${LAYERDIR}/recipes-*/*/*.bbappend"

BBFILE_COLLECTIONS += "meta-iotedge-torizon"
BBFILE_PATTERN_meta-iotedge-torizon = "^${LAYERDIR}/"
BBFILE_PRIORITY_meta-iotedge-torizon = "91"

LAYERDEPENDS_meta-iotedge-torizon = "core meta-toradex-torizon meta-iotedge tpm-layer"
LAYERSERIES_COMPAT_meta-iotedge-torizon = "kirkstone"
```
